## drivers/Kconfig
```kconfig
# Copyright (c) 2020 The ZMK Contributors
# SPDX-License-Identifier: MIT

rsource "gpio/Kconfig.595"
```

## drivers/tcs34725/Kconfig.tcs34725
```kconfig
menu "TCS34725 Sensor"
config TCS34725
    bool "TCS34725 RGB Sensor"
    default n
    depends on I2C
    help
      Enable support for the TCS34725 RGB sensor.
endmenu
```

## dts/bindings/wiegand.yaml
```yaml
description: weigand controller
include: base.yaml
compatible: "wiegand"

properties:
    gpios:
      type: phandle-array
      required: true

    label:
      type: string
      description: Descriptive name of the key
```
